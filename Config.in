## Config.in
```kconfig
menu "LIVI OS packages"
source "$BR2_EXTERNAL_LIVI_OS_PATH/package/livi/Config.in"
source "$BR2_EXTERNAL_LIVI_OS_PATH/package/minidsp-rs/Config.in"
source "$BR2_EXTERNAL_LIVI_OS_PATH/package/retroarch/Config.in"
source "$BR2_EXTERNAL_LIVI_OS_PATH/package/retroarch-assets/Config.in"
source "$BR2_EXTERNAL_LIVI_OS_PATH/package/retroarch-joypad-autoconfig/Config.in"
source "$BR2_EXTERNAL_LIVI_OS_PATH/package/livi-homebrew/Config.in"
source "$BR2_EXTERNAL_LIVI_OS_PATH/package/libretro-cores/Config.in"
endmenu
```

## configs/livi_rpi4_defconfig
```kconfig
BR2_aarch64=y
BR2_cortex_a72=y
BR2_ARM_FPU_VFPV4=y
BR2_TOOLCHAIN_EXTERNAL=y
BR2_TOOLCHAIN_EXTERNAL_BOOTLIN=y
BR2_TOOLCHAIN_EXTERNAL_BOOTLIN_AARCH64_GLIBC_STABLE=y
BR2_CCACHE=y
BR2_STRIP_EXCLUDE_FILES="LIVI.AppImage"
BR2_CCACHE_DIR="$(BR2_EXTERNAL_LIVI_OS_PATH)/.buildroot-ccache/pi4"
BR2_CCACHE_INITIAL_SETUP="--max-size=2G"
BR2_DOWNLOAD_FORCE_CHECK_HASHES=y
BR2_GLOBAL_PATCH_DIR="board/raspberrypi/patches $(BR2_EXTERNAL_LIVI_OS_PATH)/patches"
BR2_TARGET_GENERIC_HOSTNAME="livi"
BR2_TARGET_GENERIC_ISSUE="LIVI OS (immutable root)"
# BR2_TARGET_ENABLE_ROOT_LOGIN is not set
BR2_INIT_SYSTEMD=y
# BR2_TARGET_GENERIC_REMOUNT_ROOTFS_RW is not set
BR2_INIT_SYSTEMD_VAR_FACTORY=y
BR2_ROOTFS_DEVICE_CREATION_DYNAMIC_EUDEV=y
BR2_ROOTFS_OVERLAY="$(BR2_EXTERNAL_LIVI_OS_PATH)/board/drskunk/livi/rootfs-overlay"
BR2_ROOTFS_USERS_TABLES="$(BR2_EXTERNAL_LIVI_OS_PATH)/board/drskunk/livi/users.txt"
BR2_ROOTFS_POST_BUILD_SCRIPT="$(BR2_EXTERNAL_LIVI_OS_PATH)/board/drskunk/livi/post-build.sh"
BR2_ROOTFS_POST_FAKEROOT_SCRIPT="$(BR2_EXTERNAL_LIVI_OS_PATH)/board/drskunk/livi/post-fakeroot.sh"
BR2_ROOTFS_POST_FAKEROOT_SCRIPT_ARGS="$(BR2_EXTERNAL_LIVI_OS_PATH)"
BR2_ROOTFS_POST_IMAGE_SCRIPT="$(BR2_EXTERNAL_LIVI_OS_PATH)/board/drskunk/livi/post-image.sh"
BR2_ROOTFS_POST_SCRIPT_ARGS="rpi4"
BR2_LINUX_KERNEL=y
BR2_LINUX_KERNEL_CUSTOM_TARBALL=y
BR2_LINUX_KERNEL_CUSTOM_TARBALL_LOCATION="$(call github,raspberrypi,linux,21b410140c47ffab5668399f6f143c7d7b935c8b)/linux-21b410140c47ffab5668399f6f143c7d7b935c8b.tar.gz"
BR2_LINUX_KERNEL_DEFCONFIG="bcm2711"
BR2_LINUX_KERNEL_CONFIG_FRAGMENT_FILES="$(BR2_EXTERNAL_LIVI_OS_PATH)/board/drskunk/livi/linux.fragment"
BR2_LINUX_KERNEL_DTS_SUPPORT=y
BR2_LINUX_KERNEL_INTREE_DTS_NAME="broadcom/bcm2711-rpi-4-b broadcom/bcm2711-rpi-400 broadcom/bcm2711-rpi-cm4"
BR2_LINUX_KERNEL_NEEDS_HOST_OPENSSL=y
BR2_PACKAGE_RPI_FIRMWARE=y
BR2_PACKAGE_RPI_FIRMWARE_VARIANT_PI4=y
BR2_PACKAGE_RPI_FIRMWARE_CONFIG_FILE="$(BR2_EXTERNAL_LIVI_OS_PATH)/board/drskunk/livi/config-rpi4.txt"
BR2_PACKAGE_RPI_FIRMWARE_CMDLINE_FILE="$(BR2_EXTERNAL_LIVI_OS_PATH)/board/drskunk/livi/cmdline-rpi4.txt"
BR2_PACKAGE_RPI_FIRMWARE_INSTALL_DTB_OVERLAYS=y
BR2_PACKAGE_KMOD=y
BR2_PACKAGE_KMOD_TOOLS=y
BR2_PACKAGE_XZ=y
BR2_PACKAGE_HOST_KMOD_XZ=y
BR2_PACKAGE_BUSYBOX_SHOW_OTHERS=y
BR2_PACKAGE_COREUTILS=y
BR2_PACKAGE_OPENSSH=y
BR2_PACKAGE_SQUASHFS=y
BR2_PACKAGE_SQUASHFS_XZ=y
BR2_PACKAGE_LIVI=y
BR2_PACKAGE_PSPLASH=y
BR2_PACKAGE_PSPLASH_IMAGE="$(BR2_EXTERNAL_LIVI_OS_PATH)/board/drskunk/livi/boot-splash.png"
# BR2_PACKAGE_PSPLASH_PROGRESS_BAR is not set
# BR2_PACKAGE_PSPLASH_STARTUP_MSG is not set
BR2_PACKAGE_PSPLASH_FULL_SCREEN=y
BR2_PACKAGE_FONTCONFIG=y
BR2_PACKAGE_DEJAVU=y
BR2_PACKAGE_IPROUTE2=y
BR2_PACKAGE_XORG7=y
BR2_PACKAGE_XLIB_LIBX11=y
BR2_PACKAGE_XLIB_LIBXEXT=y
BR2_PACKAGE_XLIB_LIBXFIXES=y
BR2_PACKAGE_XLIB_LIBXRANDR=y
BR2_PACKAGE_MINIDSP_RS=y
BR2_PACKAGE_RETROARCH=y
BR2_PACKAGE_LIVI_LIBRETRO_CORES=y
BR2_PACKAGE_LIVI_HOMEBREW=y
BR2_PACKAGE_MESA3D=y
BR2_PACKAGE_MESA3D_GALLIUM_DRIVER_V3D=y
BR2_PACKAGE_MESA3D_OPENGL_ES=y
BR2_PACKAGE_MESA3D_GBM=y
BR2_PACKAGE_LIBDRM=y
# The bundled libav decoder needs these libraries even for software decoding.
BR2_PACKAGE_LIBVA=y
BR2_PACKAGE_LIBSSH=y
BR2_PACKAGE_VULKAN_LOADER=y
BR2_PACKAGE_LIBINPUT=y
BR2_PACKAGE_SEATD=y
BR2_PACKAGE_SEATD_DAEMON=y
BR2_PACKAGE_WAYLAND=y
BR2_PACKAGE_LIBXKBCOMMON=y
BR2_PACKAGE_LIBGUDEV=y
BR2_PACKAGE_DBUS=y
BR2_PACKAGE_DBUS_DAEMON=y
BR2_PACKAGE_ALSA_UTILS=y
BR2_PACKAGE_PULSEAUDIO=y
# BR2_PACKAGE_PULSEAUDIO_DAEMON is not set
BR2_PACKAGE_SBC=y
BR2_PACKAGE_XDG_USER_DIRS=y
BR2_PACKAGE_PIPEWIRE=y
BR2_PACKAGE_LUA=y
BR2_PACKAGE_LUA_5_4=y
BR2_PACKAGE_WIREPLUMBER=y
BR2_PACKAGE_BLUEZ5_UTILS=y
BR2_PACKAGE_BLUEZ5_UTILS_CLIENT=y
BR2_PACKAGE_BLUEZ5_UTILS_TOOLS=y
BR2_PACKAGE_BLUEZ5_UTILS_PLUGINS_AUDIO=y
BR2_PACKAGE_BRCMFMAC_SDIO_FIRMWARE_RPI=y
BR2_PACKAGE_BRCMFMAC_SDIO_FIRMWARE_RPI_BT=y
BR2_PACKAGE_BRCMFMAC_SDIO_FIRMWARE_RPI_WIFI=y
BR2_PACKAGE_HOSTAPD=y
BR2_PACKAGE_HOSTAPD_DRIVER_NL80211=y
BR2_PACKAGE_NETWORK_MANAGER=y
BR2_PACKAGE_NETWORK_MANAGER_CLI=y
BR2_PACKAGE_WPA_SUPPLICANT=y
BR2_PACKAGE_WPA_SUPPLICANT_NL80211=y
BR2_PACKAGE_DNSMASQ=y
BR2_PACKAGE_DNSMASQ_DHCP=y
BR2_PACKAGE_IW=y
BR2_PACKAGE_UTIL_LINUX_RFKILL=y
BR2_PACKAGE_AVAHI=y
BR2_PACKAGE_AVAHI_DAEMON=y
BR2_PACKAGE_PYTHON3=y
BR2_PACKAGE_PYTHON3_SSL=y
BR2_PACKAGE_PYTHON3_PYEXPAT=y
BR2_PACKAGE_LIBGPIOD_TOOLS=y
BR2_PACKAGE_LIBCURL_CURL=y
BR2_PACKAGE_LIBFUSE=y
BR2_PACKAGE_LIBFUSE3=y
BR2_PACKAGE_JQ=y
BR2_PACKAGE_SUDO=y
BR2_PACKAGE_PROCPS_NG=y
BR2_PACKAGE_E2FSPROGS=y
BR2_PACKAGE_E2FSPROGS_FSCK=y
BR2_PACKAGE_E2FSPROGS_RESIZE2FS=y
BR2_PACKAGE_UTIL_LINUX_BINARIES=y
BR2_PACKAGE_UTIL_LINUX_PARTX=y
BR2_PACKAGE_LIBOPENSSL_BIN=y
BR2_PACKAGE_DOSFSTOOLS=y
BR2_PACKAGE_DOSFSTOOLS_FSCK_FAT=y
BR2_TARGET_ROOTFS_SQUASHFS=y
BR2_TARGET_ROOTFS_SQUASHFS4_XZ=y
# BR2_TARGET_ROOTFS_TAR is not set
BR2_PACKAGE_HOST_DOSFSTOOLS=y
BR2_PACKAGE_HOST_E2FSPROGS=y
BR2_PACKAGE_HOST_GENIMAGE=y
BR2_PACKAGE_HOST_MTOOLS=y
```

## configs/livi_rpi5_defconfig
```kconfig
BR2_aarch64=y
BR2_cortex_a76=y
BR2_TOOLCHAIN_EXTERNAL=y
BR2_TOOLCHAIN_EXTERNAL_BOOTLIN=y
BR2_TOOLCHAIN_EXTERNAL_BOOTLIN_AARCH64_GLIBC_STABLE=y
BR2_CCACHE=y
BR2_CCACHE_DIR="$(BR2_EXTERNAL_LIVI_OS_PATH)/.buildroot-ccache/pi5"
BR2_CCACHE_INITIAL_SETUP="--max-size=2G"
BR2_DOWNLOAD_FORCE_CHECK_HASHES=y
BR2_GLOBAL_PATCH_DIR="board/raspberrypi/patches $(BR2_EXTERNAL_LIVI_OS_PATH)/patches"
BR2_TARGET_GENERIC_HOSTNAME="livi"
BR2_TARGET_GENERIC_ISSUE="LIVI OS (immutable root)"
BR2_INIT_SYSTEMD=y
# BR2_TARGET_GENERIC_REMOUNT_ROOTFS_RW is not set
BR2_INIT_SYSTEMD_VAR_FACTORY=y
BR2_ROOTFS_DEVICE_CREATION_DYNAMIC_EUDEV=y
BR2_ROOTFS_OVERLAY="$(BR2_EXTERNAL_LIVI_OS_PATH)/board/drskunk/livi/rootfs-overlay"
BR2_ROOTFS_USERS_TABLES="$(BR2_EXTERNAL_LIVI_OS_PATH)/board/drskunk/livi/users.txt"
BR2_ROOTFS_POST_BUILD_SCRIPT="$(BR2_EXTERNAL_LIVI_OS_PATH)/board/drskunk/livi/post-build.sh"
BR2_ROOTFS_POST_IMAGE_SCRIPT="$(BR2_EXTERNAL_LIVI_OS_PATH)/board/drskunk/livi/post-image.sh"
BR2_ROOTFS_POST_SCRIPT_ARGS="rpi5"
BR2_LINUX_KERNEL=y
BR2_LINUX_KERNEL_CUSTOM_TARBALL=y
BR2_LINUX_KERNEL_CUSTOM_TARBALL_LOCATION="$(call github,raspberrypi,linux,21b410140c47ffab5668399f6f143c7d7b935c8b)/linux-21b410140c47ffab5668399f6f143c7d7b935c8b.tar.gz"
BR2_LINUX_KERNEL_DEFCONFIG="bcm2712"
BR2_LINUX_KERNEL_CONFIG_FRAGMENT_FILES="board/raspberrypi/linux-4k-page-size.fragment $(BR2_EXTERNAL_LIVI_OS_PATH)/board/drskunk/livi/linux.fragment"
BR2_LINUX_KERNEL_DTS_SUPPORT=y
BR2_LINUX_KERNEL_INTREE_DTS_NAME="broadcom/bcm2712-rpi-5-b broadcom/bcm2712d0-rpi-5-b broadcom/bcm2712-rpi-500"
BR2_LINUX_KERNEL_NEEDS_HOST_OPENSSL=y
BR2_PACKAGE_RPI_FIRMWARE=y
BR2_PACKAGE_RPI_FIRMWARE_CONFIG_FILE="$(BR2_EXTERNAL_LIVI_OS_PATH)/board/drskunk/livi/config-rpi5.txt"
BR2_PACKAGE_RPI_FIRMWARE_CMDLINE_FILE="$(BR2_EXTERNAL_LIVI_OS_PATH)/board/drskunk/livi/cmdline-rpi5.txt"
BR2_PACKAGE_RPI_FIRMWARE_INSTALL_DTB_OVERLAYS=y
BR2_PACKAGE_KMOD=y
BR2_PACKAGE_KMOD_TOOLS=y
BR2_PACKAGE_BUSYBOX_SHOW_OTHERS=y
BR2_PACKAGE_COREUTILS=y
BR2_PACKAGE_SQUASHFS=y
BR2_PACKAGE_SQUASHFS_XZ=y
BR2_PACKAGE_LIVI=y
BR2_PACKAGE_MINIDSP_RS=y
BR2_PACKAGE_RETROARCH=y
BR2_PACKAGE_LIVI_LIBRETRO_CORES=y
BR2_PACKAGE_LIVI_HOMEBREW=y
BR2_PACKAGE_MESA3D=y
BR2_PACKAGE_MESA3D_GALLIUM_DRIVER_V3D=y
BR2_PACKAGE_MESA3D_OPENGL_ES=y
BR2_PACKAGE_MESA3D_GBM=y
BR2_PACKAGE_LIBDRM=y
BR2_PACKAGE_LIBINPUT=y
BR2_PACKAGE_CAGE=y
BR2_PACKAGE_SEATD=y
BR2_PACKAGE_SEATD_DAEMON=y
BR2_PACKAGE_WLR_RANDR=y
BR2_PACKAGE_DBUS=y
BR2_PACKAGE_DBUS_DAEMON=y
BR2_PACKAGE_DBUS_PYTHON=y
BR2_PACKAGE_ALSA_UTILS=y
BR2_PACKAGE_PIPEWIRE=y
BR2_PACKAGE_LUA=y
BR2_PACKAGE_LUA_5_4=y
BR2_PACKAGE_WIREPLUMBER=y
BR2_PACKAGE_BLUEZ5_UTILS=y
BR2_PACKAGE_BLUEZ5_UTILS_CLIENT=y
BR2_PACKAGE_BLUEZ5_UTILS_TOOLS=y
BR2_PACKAGE_BLUEZ5_UTILS_PLUGINS_AUDIO=y
BR2_PACKAGE_BRCMFMAC_SDIO_FIRMWARE_RPI=y
BR2_PACKAGE_BRCMFMAC_SDIO_FIRMWARE_RPI_BT=y
BR2_PACKAGE_BRCMFMAC_SDIO_FIRMWARE_RPI_WIFI=y
BR2_PACKAGE_HOSTAPD=y
BR2_PACKAGE_HOSTAPD_DRIVER_NL80211=y
BR2_PACKAGE_NETWORK_MANAGER=y
BR2_PACKAGE_NETWORK_MANAGER_CLI=y
BR2_PACKAGE_WPA_SUPPLICANT=y
BR2_PACKAGE_WPA_SUPPLICANT_NL80211=y
BR2_PACKAGE_DNSMASQ=y
BR2_PACKAGE_DNSMASQ_DHCP=y
BR2_PACKAGE_IW=y
BR2_PACKAGE_UTIL_LINUX_RFKILL=y
BR2_PACKAGE_AVAHI=y
BR2_PACKAGE_AVAHI_DAEMON=y
BR2_PACKAGE_PYTHON3=y
BR2_PACKAGE_PYTHON3_SSL=y
BR2_PACKAGE_PYTHON3_PYEXPAT=y
BR2_PACKAGE_PYTHON_GOBJECT=y
BR2_PACKAGE_PYTHON_SMBUS2=y
BR2_PACKAGE_LIBGPIOD_TOOLS=y
BR2_PACKAGE_LIBCURL_CURL=y
BR2_PACKAGE_LIBFUSE=y
BR2_PACKAGE_LIBFUSE3=y
BR2_PACKAGE_JQ=y
BR2_PACKAGE_SUDO=y
BR2_PACKAGE_PROCPS_NG=y
BR2_PACKAGE_E2FSPROGS=y
BR2_PACKAGE_E2FSPROGS_FSCK=y
BR2_PACKAGE_E2FSPROGS_RESIZE2FS=y
BR2_PACKAGE_UTIL_LINUX_BINARIES=y
BR2_PACKAGE_UTIL_LINUX_PARTX=y
BR2_PACKAGE_LIBOPENSSL_BIN=y
BR2_PACKAGE_DOSFSTOOLS=y
BR2_PACKAGE_DOSFSTOOLS_FSCK_FAT=y
BR2_TARGET_ROOTFS_SQUASHFS=y
BR2_TARGET_ROOTFS_SQUASHFS4_XZ=y
# BR2_TARGET_ROOTFS_TAR is not set
BR2_PACKAGE_HOST_DOSFSTOOLS=y
BR2_PACKAGE_HOST_E2FSPROGS=y
BR2_PACKAGE_HOST_GENIMAGE=y
BR2_PACKAGE_HOST_MTOOLS=y
```

## package/libretro-cores/Config.in
```kconfig
config BR2_PACKAGE_LIVI_LIBRETRO_CORES
	bool "LIVI Nintendo and Sega libretro cores"
	depends on BR2_aarch64
	select BR2_PACKAGE_LIBRETRO_NESTOPIA
	select BR2_PACKAGE_LIBRETRO_SNES9X
	select BR2_PACKAGE_LIBRETRO_GAMBATTE
	select BR2_PACKAGE_LIBRETRO_MGBA
	select BR2_PACKAGE_LIBRETRO_GENESIS_PLUS_GX
	select BR2_PACKAGE_LIBRETRO_CORE_INFO
	help
	  Installs pinned cores for NES, SNES, Game Boy/Game Boy Color,
	  Game Boy Advance, Sega Genesis/Mega Drive and Sega Master System.

config BR2_PACKAGE_LIBRETRO_NESTOPIA
	bool
config BR2_PACKAGE_LIBRETRO_SNES9X
	bool
config BR2_PACKAGE_LIBRETRO_GAMBATTE
	bool
config BR2_PACKAGE_LIBRETRO_MGBA
	bool
config BR2_PACKAGE_LIBRETRO_GENESIS_PLUS_GX
	bool
config BR2_PACKAGE_LIBRETRO_CORE_INFO
	bool
```

## package/livi-homebrew/Config.in
```kconfig
config BR2_PACKAGE_LIVI_HOMEBREW
	bool "LIVI starter homebrew games"
	depends on BR2_PACKAGE_LIVI_LIBRETRO_CORES
	help
	  Red Rod Racing and Tobu Tobu Girl for the Game Boy, with credits
	  and ready-to-play playlists. ROMs are copied to LIVI_DATA on boot.
```

## package/livi/Config.in
```kconfig
config BR2_PACKAGE_LIVI
	bool "LIVI automotive head unit"
	depends on BR2_aarch64
	depends on BR2_TOOLCHAIN_USES_GLIBC
	depends on !BR2_STATIC_LIBS
	depends on BR2_INSTALL_LIBSTDCPP
	depends on BR2_TOOLCHAIN_HAS_THREADS
	depends on BR2_PACKAGE_HAS_LIBEGL
	select BR2_PACKAGE_BASH
	select BR2_PACKAGE_CA_CERTIFICATES
	select BR2_PACKAGE_LIBCURL
	select BR2_PACKAGE_FONTCONFIG
	select BR2_PACKAGE_DEJAVU
	select BR2_PACKAGE_IPROUTE2
	select BR2_PACKAGE_LIBXKBCOMMON
	select BR2_PACKAGE_SEATD
	select BR2_PACKAGE_LIBGUDEV
	select BR2_PACKAGE_XKEYBOARD_CONFIG
	help
	  Installs a Rust/Slint LIVI ARM64 AppImage implementing LIVI OS API 2.
	  At runtime it is copied to
	  the writable data partition so LIVI's atomic in-place updater works.
	  Uses the application's direct DRM/KMS compositor, not Cage or Electron.
	  The privileged Rust helper is installed separately on the immutable root.

if BR2_PACKAGE_LIVI

config BR2_PACKAGE_LIVI_APPIMAGE
	string "Path to ARM64 LIVI AppImage"
	default "$(BR2_EXTERNAL_LIVI_OS_PATH)/artifacts/LIVI-arm64.AppImage"
	help
	  Absolute path, or path interpreted by the build shell, to an ARM64
	  LIVI AppImage. Run `make fetch-livi` before building.

endif
```

## package/minidsp-rs/Config.in
```kconfig
config BR2_PACKAGE_MINIDSP_RS
	bool "minidsp-rs daemon (prebuilt ARM64)"
	depends on BR2_aarch64
	depends on BR2_TOOLCHAIN_USES_GLIBC
	select BR2_PACKAGE_LIBUSB
	help
	  Installs the upstream minidsp-rs ARM64 daemon and CLI, its udev
	  rule, configuration, and loopback HTTP service on port 5380.
```

## package/retroarch/Config.in
```kconfig
config BR2_PACKAGE_RETROARCH
	bool "RetroArch frontend for LIVI"
	depends on BR2_aarch64
	depends on !BR2_STATIC_LIBS
	depends on BR2_PACKAGE_HAS_LIBEGL
	depends on BR2_PACKAGE_HAS_LIBGLES
	depends on BR2_PACKAGE_HAS_UDEV
	select BR2_PACKAGE_ALSA_LIB
	select BR2_PACKAGE_DBUS
	select BR2_PACKAGE_LIBDRM
	select BR2_PACKAGE_LIBUSB
	select BR2_PACKAGE_PIPEWIRE
	select BR2_PACKAGE_WAYLAND
	select BR2_PACKAGE_ZLIB
	select BR2_PACKAGE_RETROARCH_ASSETS
	select BR2_PACKAGE_RETROARCH_JOYPAD_AUTOCONFIG
	help
	  RetroArch frontend built for Wayland, OpenGL ES 3, udev input and
	  ALSA. Cores and mutable assets are stored on LIVI_DATA.
```

## package/xdg-user-dirs/Config.in
```kconfig
config BR2_PACKAGE_XDG_USER_DIRS
	bool "xdg-user-dirs"
	help
	  Resolve standard user directories with xdg-user-dir.
	  https://www.freedesktop.org/wiki/Software/xdg-user-dirs/
```
